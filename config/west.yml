## config/west.yml
```yaml
manifest:
  remotes:
    - name: zmkfirmware
      url-base: https://github.com/zmkfirmware
    - name: sekigon-gonnoc
      url-base: https://github.com/sekigon-gonnoc
    - name: caksoylar
      url-base: https://github.com/caksoylar
    - name: 4mplelab
      url-base: https://github.com/4mplelab
    - name: kot149
      url-base: https://github.com/kot149
    - name: ssbb
      url-base: https://github.com/ssbb
    - name: cormoran
      url-base: https://github.com/cormoran
  projects:
    # ZMK: DYA Studio 用カスタム RPC サブシステム付き cormoran fork（ZMK v4/Zephyr 4.1）
    # roBa と同じ構成。ブラウザ（https://studio.dya.cormoran.works）から設定変更できる
    - name: zmk
      remote: cormoran
      revision: main+dya
      import: app/west.yml
    - name: zmk-driver-paw3222
      remote: sekigon-gonnoc
      revision: main
    - name: zmk-rgbled-widget
      remote: caksoylar
      # v0.3 support was split out to v0.3-branch; main now tracks ZMK main/Zephyr 4.x
      revision: main
    - name: zmk-feature-charge-indicator
      remote: 4mplelab
      revision: main
    # トラックボールジェスチャー（roBa と同じ構成）
    - name: zmk-mouse-gesture
      remote: kot149
      revision: v1
    - name: zmk-listeners
      remote: ssbb
      revision: v1
    # DYA Studio モジュール（すべて cormoran リポジトリ、main+dya と同じ main 追従）
    - name: zmk-module-ble-management
      remote: cormoran
      revision: main
    - name: zmk-module-battery-history
      remote: cormoran
      revision: main
    - name: zmk-module-settings-rpc
      remote: cormoran
      revision: main
    - name: zmk-module-runtime-input-processor
      remote: cormoran
      revision: main
    - name: zmk-feature-custom-settings
      remote: cormoran
      revision: main
    - name: zmk-feature-runtime-macro
      remote: cormoran
      revision: main
      import: true
    - name: zmk-feature-runtime-combo
      remote: cormoran
      revision: main
      import: true
  self:
    path: config
```
